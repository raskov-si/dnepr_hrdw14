/*!
\file MAX_DS28CM00.c
\brief Driver for Maxim DS28CM00 I2C silicon serial number.
\author Daniel Leonov, <a href="mailto:leonov@t8.ru">leonov@t8.ru</a>
\date 02.05.2012
*/

#include "HAL\IC\inc\MAX_DS28CM00.h"

#define DS28CM00_I2C_TIMEOUT_MS    (50)

/*!
\addtogroup MAX_DS28CM00_Driver
\{
*/

/*!
\defgroup MAX_DS28CM00_Driver_Exported_Functions
\{
*/

/*! DOW CRC (CRC8) Table. */
_Pragma("location=\"const_values\"") const u8 naCrc8Table[256]=
{
    0x00,0x5e,0xbc,0xe2,0x61,0x3f,0xdd,0x83,
    0xc2,0x9c,0x7e,0x20,0xa3,0xfd,0x1f,0x41,
    0x9d,0xc3,0x21,0x7f,0xfc,0xa2,0x40,0x1e,
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    0xb6,0xe8,0x0a,0x54,0xd7,0x89,0x6b,0x35
};

void MAX_DS28CM00_InitContentsStructure( MAX_DS28CM00_ContentsTypedef* tContents ){
	u8 i;
	
	tContents->nFamilyCode=0;	
	for(i=0; i<MAX_DS28CM00_LENGTH; i++){
		tContents->nSerialNumber[i]=0;
	}
	tContents->nCRC=0;
}


/* серийный номер шасси */

_BOOL MAX_DS28CM00_ReadContents(I2C_PeriphInterfaceTypedef* tI2cPeriphInterface,
										MAX_DS28CM00_ContentsTypedef* tContents){
	/*!
	\brief Reads contents of devices to a \c MAX_DS28CM00_ContentsTypedef structure.
	\param tContents Target structure.
	\retval 1.
	*/

	u8 i, j;
	_BOOL ret = TRUE ;

	assert( tI2cPeriphInterface != NULL );
	
	//Family code
	ret &= tI2cPeriphInterface->I2C_ReadByte(tI2cPeriphInterface, MAX_DS28CM00_ADDRESS, MAX_DS28CM00_DEVICE_FAMILY_BASE, &(tContents->nFamilyCode), DS28CM00_I2C_TIMEOUT_MS, 2);
	
	//48-bit serial number
	for(i=MAX_DS28CM00_SERIAL_NUMBER_BASE, j=0; (i<MAX_DS28CM00_CRC_BASE)&&(j<=MAX_DS28CM00_LENGTH); i++, j++){
		ret &= tI2cPeriphInterface->I2C_ReadByte(tI2cPeriphInterface, MAX_DS28CM00_ADDRESS, i, &(tContents->nSerialNumber[j]), DS28CM00_I2C_TIMEOUT_MS, 2);
	}	
	ret &= tI2cPeriphInterface->I2C_ReadByte(tI2cPeriphInterface, MAX_DS28CM00_ADDRESS, MAX_DS28CM00_CRC_BASE, &(tContents->nCRC), DS28CM00_I2C_TIMEOUT_MS, 2);
	return ret ;
}


_BOOL MAX_DS28CM00_CheckCRC( MAX_DS28CM00_ContentsTypedef* tContents){
	/*!
	\brief Checks SN and Family Code CRC (not yet implemented).
	\details Uses table-driver DOW CRC calculation.
	\param tContents Target structure.
	\retval 1 if CRC is correct, 0 otherwise.
	\todo Test CRC checking.
	*/
	
    u8 i;
    u8 nCrc=0x00;

    /* Just a standard algorythm from the interwebs */
    nCrc=naCrc8Table[ nCrc ^ tContents->nFamilyCode ];    
    for(i=0;i<MAX_DS28CM00_LENGTH;i++){
    	nCrc=naCrc8Table[ nCrc^tContents->nSerialNumber[i] ];    
    }
    nCrc=naCrc8Table[ nCrc ^ tContents->nCRC ];
	
	return (nCrc==0) ? 1 : 0;
}

_BOOL MAX_DS28CM00_SetMode(		I2C_PeriphInterfaceTypedef* tI2cPeriphInterface,
												MAX_DS28CM00_ModeTypedef mMode){
	/*!
	\brief Sets serial interface operation mode (SMBus/I2C).
	\details See datasheet for details.
	\param mMode Desired mode. See \c \ref MAX_DS28CM00_ModeTypedef.
	\retval 1 if transaction was successful, 0 otherwise.
	*/
	u8 nMode;

	assert( tI2cPeriphInterface != NULL );
	
	nMode = ( mMode == MAX_DS28CM00_I2C ) ? MAX_DS28CM00_CM_I2C : MAX_DS28CM00_CM_SMB ;	
	return tI2cPeriphInterface->I2C_WriteByte(tI2cPeriphInterface, MAX_DS28CM00_ADDRESS, MAX_DS28CM00_CONTROL_REGISTER_BASE, nMode, DS28CM00_I2C_TIMEOUT_MS, 2);
}

MAX_DS28CM00_ModeTypedef MAX_DS28CM00_GetMode( I2C_PeriphInterfaceTypedef* tI2cPeriphInterface ){
	/*!
	\brief Gets serial interface operation mode (SMBus/I2C).
	\retval Current mode. See \c \ref MAX_DS28CM00_ModeTypedef.
	*/
	u8 nMode;

	assert( tI2cPeriphInterface != NULL );
	
	tI2cPeriphInterface->I2C_ReadByte(tI2cPeriphInterface, MAX_DS28CM00_ADDRESS, MAX_DS28CM00_CONTROL_REGISTER_BASE, &nMode, DS28CM00_I2C_TIMEOUT_MS, 2 );
	return ( nMode==MAX_DS28CM00_CM_I2C ) ? MAX_DS28CM00_I2C : MAX_DS28CM00_SMB ;
}

/*!
\}
*/ //MAX_DS28CM00_Driver_Exported_Functions

/*!
\}
*/ //MAX_DS28CM00_Driver

